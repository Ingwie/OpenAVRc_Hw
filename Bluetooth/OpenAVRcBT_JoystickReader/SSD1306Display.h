#ifndef _SSD1306DISPLAY_h
#define _SSD1306DISPLAY_h

#if defined(ARDUINO) && ARDUINO >= 100
  #include "arduino.h"
#else
  #include "WProgram.h"
#endif

#include "ssd1306.h"
#include "nano_gfx.h"
#include "ssd1306_hal/io.h"
#include <stdint.h>

#include "RCState.h"

char cstr[4];

const uint8_t Sova [] PROGMEM = {
0x00, 0x00, 0x00, 0x00, 0x00, 0x00, 0x00, 0x00, 0x00, 0x00, 0x00, 0x00, 0x00, 0x00, 0x00, 0x00,
0x00, 0x00, 0x00, 0x00, 0x00, 0x00, 0x00, 0x00, 0x00, 0x00, 0x00, 0x00, 0x00, 0x00, 0x00, 0x00,
0x00, 0x00, 0x00, 0x00, 0x00, 0x00, 0x00, 0x00, 0x00, 0x00, 0x00, 0x00, 0x00, 0x00, 0x00, 0x00,
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0x00, 0x00, 0x00, 0x00, 0x00, 0x00, 0x00, 0x00, 0x00, 0x00, 0x00, 0x00, 0x00, 0x00, 0x00, 0x00,
};

const unsigned char MarilynMonroe [] PROGMEM = {
  0xff, 0xff, 0xff, 0xff, 0xff, 0xf8, 0x1f, 0xff, 0xff, 0xff, 0xff, 0xff, 0xff, 0xff, 0xff, 0xff, 
  0xff, 0xff, 0xff, 0xff, 0xff, 0xc0, 0x1f, 0xff, 0xff, 0xf0, 0x41, 0xff, 0xff, 0xff, 0xff, 0xff, 
  0xff, 0xff, 0xff, 0xff, 0xff, 0x80, 0x7f, 0xff, 0xff, 0xf8, 0x03, 0xff, 0xff, 0xff, 0xff, 0xff, 
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  0xff, 0xff, 0xff, 0xff, 0x7e, 0x00, 0x00, 0x00, 0x00, 0x00, 0x00, 0x00, 0x7f, 0xff, 0xff, 0xff
};

const uint8_t splash_OpenAVRc[] PROGMEM = {
0x00,0x00,0x00,0x00,0x00,0x10,0x38,0x78,0xFC,0xCC,0x84,0x04,0x04,0x0C,0x04,0x0C,
0x0C,0xDC,0xFC,0xFC,0x7C,0x1C,0x08,0x00,0x40,0xE0,0xE0,0xF0,0xB0,0xB0,0x30,0x30,
0x30,0x30,0x60,0xE0,0xC0,0x80,0x00,0x00,0x00,0x80,0x80,0x80,0x80,0x80,0x80,0x80,
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0x00,0x00,0x00,0x00,0x00,0x00,0x00,0x00,0x00,0x00,0x00,0x00,0x00,0x00,0x00,0x00
};

class SSD1306Display {
public:
  void setup() {
    /* Select the font to use with menu and all font functions */
    ssd1306_setFixedFont(ssd1306xled_font6x8);
    ssd1306_128x64_i2c_init();
    delay(1000); // Pause for 2 seconds

    // Clear the buffer
    ssd1306_clearScreen();
    ssd1306_drawBitmap(0, 0, 128, 64, splash_OpenAVRc);
    //ssd1306_drawBitmap(0, 0, 128, 64, Sova);
    delay(1000); // Pause for 2 seconds
  
    // Clear the buffer
    ssd1306_clearScreen();
    ssd1306_printFixed(18, 20, "Joystick  PPM", STYLE_BOLD);
    //ssd1306_printFixedN (0, 0, "Joystick  PPM", STYLE_BOLD, FONT_SIZE_2X);
    ssd1306_negativeMode();
    ssd1306_printFixed(0, 50, "**OpenAVRc  Team**", STYLE_BOLD);
    ssd1306_positiveMode();
  }

  void display_oerr() {
    ssd1306_clearScreen();
    ssd1306_printFixed(0, 0, "OSC not started", STYLE_NORMAL);
  }

  void display_herr() {
    ssd1306_clearScreen();
    ssd1306_printFixed(0, 0, "HID set error", STYLE_NORMAL);
  }

  void display_joystick_connected() {
    ssd1306_clearScreen();
    ssd1306_printFixed(0, 0, "Joystick", STYLE_NORMAL);
    ssd1306_printFixed(0, 10, "Connected", STYLE_NORMAL);
  }

  void clear() {
    ssd1306_clearScreen();
  }

  void display_joystick_disconnected() {
    ssd1306_clearScreen();
    ssd1306_printFixed(0, 0, "Joystick", STYLE_NORMAL);
    ssd1306_printFixed(0, 10, "Disconnected", STYLE_NORMAL);
  }

  int flight_mode_old,channel5_mode_old;
  byte camera_mode_old;
  bool camera_auto_center_old;
  void display(int flight_mode, int channel5_mode, byte camera_mode, bool camera_auto_center) {
    if ((flight_mode_old != flight_mode)||(channel5_mode_old != channel5_mode)||
        (camera_mode_old != camera_mode)||(camera_auto_center_old != camera_auto_center)){
          ssd1306_clearScreen();
        }
    flight_mode_old = flight_mode;
    channel5_mode_old = channel5_mode;
    camera_mode_old = camera_mode;
    camera_auto_center_old = camera_auto_center;

    ssd1306_setFixedFont(ssd1306xled_font6x8);
    ssd1306_printFixed(0, 0, "Mode:", STYLE_NORMAL);
    ssd1306_printFixed(30, 0, itoa(flight_mode, cstr, 10), STYLE_NORMAL);

    if (channel5_mode<1000)
    {
      ssd1306_printFixed(78, 0, "CH5:", STYLE_NORMAL);//oled.setCursor(13, 0);
      ssd1306_printFixed(102, 0, itoa(channel5_mode, cstr, 10), STYLE_NORMAL);
    }
    else
    {
      ssd1306_printFixed(70, 0, "CH5:", STYLE_NORMAL);//oled.setCursor(12, 0);
      ssd1306_printFixed(96, 0, itoa(channel5_mode, cstr, 10), STYLE_NORMAL);
    }

    ssd1306_printFixed(0, 20, "CMode:", STYLE_NORMAL);//oled.setCursor(0, 1);
    ssd1306_printFixed(35, 20, itoa(camera_mode, cstr, 10), STYLE_NORMAL);//oled.print(camera_mode);

    //oled.setCursor(17, 1);
    if (camera_auto_center) {
      ssd1306_printFixed(100, 20, "CEN", STYLE_NORMAL);
    }

    //display_rc(flight_mode, channel5, camera_mode, camera_auto_center);
  }

  void write_mode(RCState *rcs) {
    ssd1306_printFixed(0, 35, "M", STYLE_NORMAL);
    ssd1306_printFixed(10, 35, itoa(rcs->flight_mode, cstr, 10), STYLE_NORMAL);
  }

  void write_ch5_simple_mode(RCState *rcs) {
    //oled.setCursor(3, 2);
    if (rcs->channel5_mode == 1000) {
      ssd1306_printFixed(40, 35, "+", STYLE_NORMAL);//oled.print("+");
    }
    else {
      ssd1306_printFixed(40, 35, "o", STYLE_NORMAL);//oled.print("o");
    }
  }
  
  RCState *rcs_old;
  void write_camera_mode(RCState *rcs) {
    switch (rcs->camera_mode) {
    case CAMERA_MODES::exponent:
      ssd1306_printFixed(60, 35, "*", STYLE_NORMAL);//oled.print("*");
      break;
    case CAMERA_MODES::slow:
      ssd1306_printFixed(60, 35, "#", STYLE_NORMAL);//oled.print("#");
      break;
    case CAMERA_MODES::max_min:
      ssd1306_printFixed(60, 35, "@"//(char)B11011011
      , STYLE_NORMAL);//oled.print((char)B11011011);
      break;
    }

    if (rcs->auto_center) {
      ssd1306_printFixed(60, 35, "+", STYLE_NORMAL);//oled.print("+");
    }
    else {
      ssd1306_printFixed(60, 35, "$"//(char)B11110011
      , STYLE_NORMAL);//oled.print((char)B11110011);
    }
  }

  void write_number_value(uint8_t x, uint8_t y, int value,RCState *rcs) {
    auto mapped_value = map(value, rcs->MIN_VALUE, rcs->MAX_VALUE, -99, +99);
    if (mapped_value >= 0) {
      ssd1306_printFixed(x, y, "   ", STYLE_NORMAL);//oled.print(" ");
    }
    if (mapped_value < 10 && mapped_value> -10) {
      ssd1306_printFixed(x, y, " ", STYLE_NORMAL);//oled.print(" ");
    }
    ssd1306_printFixed(x, y, itoa(mapped_value, cstr, 10), STYLE_NORMAL);//oled.print(mapped_value);
  }

  void write_unsigned_number_value(uint8_t x, uint8_t y, int value, RCState *rcs) {
    auto mapped_value = map(value, rcs->MIN_VALUE, rcs->MAX_VALUE, 0, +99);
    if (mapped_value >= 0) {
      ssd1306_printFixed(x, y, " ", STYLE_NORMAL);//oled.print(" ");
    }
    if (mapped_value < 10 && mapped_value> -10) {
      ssd1306_printFixed(x, y, "   ", STYLE_NORMAL);//oled.print(" ");
    }
    ssd1306_printFixed(x, y, itoa(mapped_value, cstr, 10), STYLE_NORMAL);//oled.print(mapped_value);
  }

  void write_camera_values(RCState *rcs) {
    write_number_value(80, 35, rcs->camera_yaw, rcs);
    write_number_value(100, 35,rcs->camera_pitch, rcs);
  }


  void print_all(RCState *rcs) {
    write_mode(rcs);

    write_ch5_simple_mode(rcs);

    write_camera_mode(rcs);
    write_camera_values(rcs);

    write_number_value(0, 50, rcs->elevator, rcs);
    write_number_value(30, 50, rcs->aileron,rcs);
    write_unsigned_number_value(60, 50, rcs->throttle,rcs);
    write_number_value(90, 50, rcs->rudder,rcs);

    
  }

  void loop() {

  }
/*
  void displayPercentage(uint8_t char_id, uint8_t value) {
    byte char_remainder[3] = {
      0b00100,
      0b01110,
      0b11111
    };

    const int options = 24;
    const int rows = 8;
    const int cols = 3;

    auto mapped_value = map(value, 0, 100, 0, 24);
    auto row = mapped_value / 3;
    auto col = mapped_value % 3;

    byte char_value[8] = {0};
    for (auto i = 8; i > row; i--) {
      char_value[i] = 0b11111;
    }
    char_value[row] = char_remainder[col];
    oled.createChar(char_id, char_value);
  }

  void display_rx_rssi(uint8_t value) {
    oled.setCursor(14, 1);

    if (value == 255) {
      oled.print("x");
    }
    else {
      displayPercentage(0, value);
      oled.print((char)0);
    }
  }

  void display_tx_rssi(uint8_t value) {
    oled.setCursor(15, 1);

    if (value == 255) {
      oled.print("x");
    }
    else {
      displayPercentage(1, value);
      oled.print((char)1);
    }
  }
*/

};
#endif
